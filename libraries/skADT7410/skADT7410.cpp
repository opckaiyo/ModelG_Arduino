/*******************************************************************************
*  skADT7410 - 温度センサADT7410用関数ライブラリ                               *
*                                                                              *
*    skADT7410  - この関数ライブラリを生成する時の初期化処理                   *
*    Begin      - 温度センサの初期化を行う処理                                 *
*    ActionMode - 温度センサの動作モードを設定する処理                         *
*    Receive    - 温度センサから指定個数のデータを受信する処理                 *
*    Send       - 温度センサに指定個数のデータを送信する処理                   *
*    Read       - 温度センサから読込みを行い温度値を返す処理                   *
* ============================================================================ *
*   VERSION  DATE        BY             CHANGE/COMMENT                         *
* ---------------------------------------------------------------------------- *
*   1.00     2015-06-05  きむ茶工房     Create                                 *
* ============================================================================ *
*   Arduino IDE 1.7.3    (Ardino Duemilanove 328/UNO)(Arduino Zero Pro)        *
*******************************************************************************/
#include <Wire.h>
#include "arduino.h"
#include "skADT7410.h"


/*******************************************************************************
*  skADT7410(address)                                                          *
*    この関数ライブラリを生成する時の初期化処理(コンストラクタ)                *
*    address : 方位センサ(スレーブ)のI2Cアドレスを指定します                   *
*******************************************************************************/
skADT7410::skADT7410(uint8_t address)
{
     Sensor_adrs = address ;
}
/*******************************************************************************
*  ans = Begin()                                                               *
*    温度センサの初期化を行う処理                                              *
*    設定のデータは16bitの分解能です。                                         *
*    (INT/CTの機能は利用しないのでデフォルトのままです)                        *
*    初期デバイスの動作モードは"シャットダウン"でスタートです。                *
*    ans  : 戻り値、0=正常終了　それ以外I2C通信エラー下記                      *
*                   1=送ろうとしたデータが送信バッファのサイズを超えた         *
*                   2=スレーブ・アドレスを送信し、NACKを受信した               *
*                   3=データ・バイトを送信し、NACKを受信した                   *
*                   4=その他のエラー                                           *
*                   5=データ受信エラー                                         *
*******************************************************************************/
uint8_t skADT7410::Begin()
{
     uint8_t  ans ;
     unsigned char data[2] ;

     // 方位センサを初期化する処理
     data[0] = CONF_REG_DATA ;    // コンフィギュレーションの設定(16bit  Shutdown Mode)
     ans = Send(CONF_REG_ADRS,&data[0],1) ;
     return ans ;
}
/*******************************************************************************
*  ans = ActionMode(mode)                                                      *
*  温度センサの動作モード(測定モード)を設定する処理                            *
*    mode: 動作モードを指定する                                                *
*          ADT_MODE_SHUTDOWN／ADT_MODE_ONESHOT／ADT_MODE_CONTINUE/ADT_MODE_1SPS*
*    ans : 戻り値、0=正常終了　それ以外Begin()のans値を参照                    *
*******************************************************************************/
uint8_t skADT7410::ActionMode(uint8_t mode)
{
     uint8_t  ans ;
     unsigned char data[2] ;

     // 現在の設定情報を読み出す
     ans = Receive(CONF_REG_ADRS,&data[0],1) ;
     if (ans == 0) {
          data[2] = (data[0] && 0x10011111) || mode ;
          ans = Send(CONF_REG_ADRS,&data[2],1) ;
     }
     return ans ;
}
/*******************************************************************************
*  ans = Receive(reg_adrs,*data,kosu)                                          *
*  温度センサから指定個数のデータを受信する処理                                *
*    reg_adrs : 読出すデータのレジスターアドレスを指定する                     *
*               連続的に読出す場合は、読出すレジスターの先頭アドレスを指定     *
*    *data    : 読出したデータの格納先を指定する                               *
*    kosu     : 読出すデータのバイト数を指定する                               *
*    ans      : 戻り値、0=正常終了　それ以外Begin()のans値を参照               *
*******************************************************************************/
uint8_t skADT7410::Receive(char reg_adrs,unsigned char *data,char kosu)
{
     uint8_t  ans , i ;

     Wire.beginTransmission(Sensor_adrs) ;             // 通信の開始
     Wire.write(reg_adrs) ;                            // レジスタアドレスを指定
     ans = Wire.endTransmission() ;                    // データの送信と通信の終了
     if (ans == 0) {
          ans = Wire.requestFrom((int)Sensor_adrs,(int)kosu) ;   // データの受信を行う
          if (ans == kosu) {
               for (i=0 ; i<kosu ; i++) {
                    *data = Wire.read() ;
                    data++ ;
               }
               ans = 0 ;
          } else ans = 5 ;                             // 受信バイト数がおかしい？
     }
     return ans ;
}
/*******************************************************************************
*  ans = Send(reg_adrs,*data,kosu)                                             *
*  温度センサに指定個数のデータを送信する処理                                  *
*    reg_adrs : 書出すデータのレジスターアドレスを指定する                     *
*               連続的に書出す場合は、書出すレジスターの先頭アドレスを指定     *
*    *data    : 書出すデータの格納先を指定する                                 *
*    kosu     : 書出すデータのバイト数を指定する                               *
*    ans      : 戻り値、0=正常終了　それ以外Begin()のans値を参照               *
*******************************************************************************/
uint8_t skADT7410::Send(char reg_adrs,unsigned char *data,char kosu)
{
     uint8_t  ans , i ;

     Wire.beginTransmission(Sensor_adrs) ;        // 通信の開始
     Wire.write(reg_adrs) ;                       // レジスタのアドレスを通知
     for (i=0 ; i<kosu ; i++) {
          Wire.write(*data) ;                     // データを通知
          data++ ;
     }
     ans = Wire.endTransmission() ;               // データの送信と通信の終了
     return ans ;
}
/*******************************************************************************
*  ans = Read(*temp)                                                           *
*  温度センサから読込みを行い温度値を返す処理                                  *
*  温度センサより読み込んだデータは、摂氏温度に変換し"temp"にセットする。      *
*    temp : 摂氏温度を返すのでfloat変数のアドレスを指定                        *
*    ans  : 戻り値、0=正常終了　それ以外Begin()のans値を参照                   *
*******************************************************************************/
uint8_t skADT7410::Read(float *temp)
{
     long t ;
     uint8_t  ans ;
     unsigned char data[2] ;

     ans = Receive(TEMP_DATA_ADRS,&data[0],2) ;
     if (ans == 0) {
          t = (data[0] << 8) | data[1] ;
          if (t < 0) t = t - 65536 ;
          *temp = (float)t / 128.0 ;
     }
     return ans ;
}
